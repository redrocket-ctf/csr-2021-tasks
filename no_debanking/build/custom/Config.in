## no_debanking/build/custom/configs/challenge_defconfig
```kconfig
BR2_x86_64=y
BR2_CCACHE=y
BR2_CCACHE_DIR="/tmp/.buildroot-ccache"
BR2_GLOBAL_PATCH_DIR="$(BR2_EXTERNAL_CHALLENGE_PATH)/board/patches/"
BR2_TOOLCHAIN_BUILDROOT_WCHAR=y
BR2_TARGET_GENERIC_HOSTNAME="Super secure system"
BR2_TARGET_GENERIC_ISSUE="This system is incredibly secure."
BR2_ROOTFS_DEVICE_TABLE="$(BR2_EXTERNAL_CHALLENGE_PATH)/board/device_table.txt"
BR2_ROOTFS_DEVICE_TABLE_SUPPORTS_EXTENDED_ATTRIBUTES=y
BR2_TARGET_GENERIC_ROOT_PASSWD="04a6faaec3293074ff17828fe245530a"
BR2_ROOTFS_USERS_TABLES="$(BR2_EXTERNAL_CHALLENGE_PATH)/board/user_table.txt"
BR2_ROOTFS_OVERLAY="$(BR2_EXTERNAL_CHALLENGE_PATH)/board/overlay"
BR2_ROOTFS_POST_BUILD_SCRIPT="$(BR2_EXTERNAL_CHALLENGE_PATH)/board/post-build.sh"
BR2_ROOTFS_POST_IMAGE_SCRIPT="$(BR2_EXTERNAL_CHALLENGE_PATH)/board/post-image.sh"
BR2_ROOTFS_POST_SCRIPT_ARGS="$(BR2_DEFCONFIG)"
BR2_LINUX_KERNEL=y
BR2_LINUX_KERNEL_CUSTOM_VERSION=y
BR2_LINUX_KERNEL_CUSTOM_VERSION_VALUE="5.10.79"
BR2_LINUX_KERNEL_USE_CUSTOM_CONFIG=y
BR2_LINUX_KERNEL_CUSTOM_CONFIG_FILE="$(BR2_EXTERNAL_CHALLENGE_PATH)/board/linux.config"
BR2_PACKAGE_BUSYBOX_CONFIG="$(BR2_EXTERNAL_CHALLENGE_PATH)/board/busybox.config"
BR2_PACKAGE_LTRACE=y
BR2_PACKAGE_STRACE=y
BR2_PACKAGE_LIBCAP=y
BR2_PACKAGE_LIBCAP_TOOLS=y
BR2_PACKAGE_FILE=y
BR2_PACKAGE_ATTR=y
BR2_TARGET_ROOTFS_EXT2=y
BR2_TARGET_ROOTFS_EXT2_4=y
BR2_TARGET_ROOTFS_EXT2_SIZE="20M"
BR2_TARGET_ROOTFS_EXT2_MKFS_OPTIONS="-O 64bit"
# BR2_TARGET_ROOTFS_TAR is not set
BR2_PACKAGE_SECRET_APP=y
```

## no_debanking/build/custom/package/secret_app/Config.in
```kconfig
config BR2_PACKAGE_SECRET_APP
        bool "secretapp"
        help
          This is the challenge app.
```
